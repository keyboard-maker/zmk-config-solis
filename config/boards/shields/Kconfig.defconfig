## config/boards/shields/Kconfig.defconfig
```kconfig
if SHIELD_KYRIA_LEFT || SHIELD_KYRIA_REV2_LEFT || SHIELD_KYRIA_REV3_LEFT

config ZMK_KEYBOARD_NAME
    default "Kyria"

config ZMK_SPLIT_ROLE_CENTRAL
    default y

endif

if  SHIELD_KYRIA_REV3_RIGHT || SHIELD_KYRIA_REV3_LEFT

config ZMK_SPLIT
    default y


endif
```

## config/boards/shields/Kconfig.shield
```kconfig
# Copyright (c) 2020 Pete Johanson
# SPDX-License-Identifier: MIT

config SHIELD_KYRIA_REV3_LEFT
    def_bool $(shields_list_contains,kyria_rev3_left)
    

config SHIELD_KYRIA_REV3_RIGHT
    def_bool $(shields_list_contains,kyria_rev3_right)
    
```

## config/boards/shields/solaris_left/Kconfig.defconfig
```kconfig
if SHIELD_SOLARIS_LEFT

config ZMK_KEYBOARD_NAME
    default "Ksolaris"

config ZMK_SPLIT_ROLE_CENTRAL
    default y

endif
if SHIELD_SOLARIS_LEFT || SHIELD_SOLARIS_RIGHT

config ZMK_SPLIT
    default y

endif
```

## config/boards/shields/solaris_left/Kconfig.shield
```kconfig
config SHIELD_KYRIA_LEFT
    def_bool $(shields_list_contains,solaris_left)

config SHIELD_KYRIA_RIGHT
    def_bool $(shields_list_contains,solaris_right)
```
