/*
 * Copyright (c) 2023 The ZMK Contributors
 *
 * SPDX-License-Identifier: MIT
 */

#include "kyria_rev3.dtsi"

kscan0 {
&kscan0 {
    diode-direction = "col2row";
    row-gpios
        = <&gpio0 21 (GPIO_ACTIVE_HIGH | GPIO_PULL_DOWN)>
        , <&gpio0 20 (GPIO_ACTIVE_HIGH | GPIO_PULL_DOWN)>
        , <&gpio0 19 (GPIO_ACTIVE_HIGH | GPIO_PULL_DOWN)>
        , <&gpio0 18 (GPIO_ACTIVE_HIGH | GPIO_PULL_DOWN)>
        ;
    col-gpios
        = <&gpio0 0 GPIO_ACTIVE_HIGH>
        , <&gpio0 1 GPIO_ACTIVE_HIGH>
        , <&gpio0 2 GPIO_ACTIVE_HIGH>
        , <&gpio0 3 GPIO_ACTIVE_HIGH>
        , <&gpio0 4 GPIO_ACTIVE_HIGH>
        , <&gpio0 5 GPIO_ACTIVE_HIGH>
        , <&gpio0 6 GPIO_ACTIVE_HIGH>
        ;
};


